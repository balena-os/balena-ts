## layers/meta-balena-ts/conf/layer.conf
```bitbake
BBPATH .= ":${LAYERDIR}"

BBFILES += "${LAYERDIR}/recipes-*/*/*.bb \
            ${LAYERDIR}/recipes-*/*/*.bbappend"

BBFILE_COLLECTIONS += "balena-ts"
BBFILE_PATTERN_balena-ts := "^${LAYERDIR}/"
BBFILE_PRIORITY_balena-ts = "1337"

LAYERSERIES_COMPAT_balena-ts = "sumo"

# Mask temporary the qt5 bbappends
BBMASK ?= ".*/meta-ts/recipes-qt/qt5/"
```

## layers/meta-balena-ts/conf/machine/ts4900.conf
```bitbake
include conf/machine/tsimx6.conf

PREFERRED_PROVIDER_u-boot ?= "u-boot-ts"
PREFERRED_PROVIDER_virtual/bootloader = "u-boot-ts"

UBOOT_CONFIG ??= "single quad"
UBOOT_CONFIG[single] = "ts4900-s-1g-800mhz-i_defconfig"
UBOOT_CONFIG[quad] = "ts4900-q-2g-1000mhz-c_defconfig"
```

## layers/meta-resin-ts/conf/layer.conf
```bitbake
BBPATH .= ":${LAYERDIR}"

BBFILES += "${LAYERDIR}/recipes-*/*/*.bb \
            ${LAYERDIR}/recipes-*/*/*.bbappend"

BBFILE_COLLECTIONS += "resin-ts"
BBFILE_PATTERN_resin-ts := "^${LAYERDIR}/"
BBFILE_PRIORITY_resin-ts = "1337"

# Mask temporary the qt5 bbappends
BBMASK ?= ".*/meta-ts/recipes-qt/qt5/"

# Downgrade GCC 5.2 -> 4.9.3
# Because current revision of u-boot-ts and linux-pxa16 do not have support for GCC5
# u-boot-ts  : https://github.com/embeddedarm/u-boot/issues/2
# linux-pxa16: https://github.com/embeddedarm/linux-3.14-pxa16x/issues/1
GCCVERSION = "4.9%"
SDKGCCVERSION = "4.9%"
```
